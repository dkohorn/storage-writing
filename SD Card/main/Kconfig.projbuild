## SD Card/main/Kconfig.projbuild
```kconfig
menu "SD Library Configuration"

    menu "SPI Config"
        config PIN_MOSI
            int "MOSI GPIO number"
            default 11

        config PIN_MISO
            int "MISO GPIO number"
            default 13

        config PIN_CLK
            int "CLK GPIO number"
            default 12

        config PIN_CS
            int "CS GPIO number"
            default -1  

        config SPI_BUS
            int "SPI Bus Slot"
            range 0 2
            default 1
            help 
                0 -> Bus 1
                1 -> Bus 2
                2 -> Bus 3
    endmenu
    
endmenu
```
